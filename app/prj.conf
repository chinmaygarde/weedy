## CMakeLists.txt
```
cmake_minimum_required(VERSION 3.20.0)

find_package(Zephyr REQUIRED HINTS $ENV{ZEPHYR_BASE})
project(weedy)

# Pigweed links its libraries into zephyr_interface, which everything in
# Zephyr links, including the libraries that generate headers such as
# zephyr/heap_constants.h (included by kernel.h). Pigweed's libraries then
# have to build before those headers exist, so a clean build fails. Link
# them into the app instead and order them after header generation, as
# Zephyr does for its own libraries.
get_target_property(zephyr_interface_libs zephyr_interface INTERFACE_LINK_LIBRARIES)
set(pigweed_libs ${zephyr_interface_libs})
list(FILTER pigweed_libs INCLUDE REGEX "^pw_")
list(FILTER zephyr_interface_libs EXCLUDE REGEX "^pw_")
set_property(TARGET zephyr_interface PROPERTY INTERFACE_LINK_LIBRARIES ${zephyr_interface_libs})
target_link_libraries(app PRIVATE ${pigweed_libs})

function(depend_on_zephyr_generated_headers dir)
  get_property(targets DIRECTORY ${dir} PROPERTY BUILDSYSTEM_TARGETS)
  foreach(target IN LISTS targets)
    get_target_property(type ${target} TYPE)
    if(type MATCHES "^(STATIC|OBJECT)_LIBRARY$")
      add_dependencies(${target} zephyr_generated_headers)
    endif()
  endforeach()
  get_property(subdirs DIRECTORY ${dir} PROPERTY SUBDIRECTORIES)
  foreach(subdir IN LISTS subdirs)
    depend_on_zephyr_generated_headers(${subdir})
  endforeach()
endfunction()
depend_on_zephyr_generated_headers(${ZEPHYR_PIGWEED_MODULE_DIR})

target_sources(app PRIVATE src/main.cc)
target_compile_options(app PRIVATE -Wall -Wextra -Werror)
target_link_libraries(app PRIVATE pw_digital_io_zephyr pw_log)
```

## prj.conf
```kconfig
CONFIG_GPIO=y
CONFIG_LOG=y

# C++
CONFIG_CPP=y
CONFIG_STD_CPP20=y
CONFIG_REQUIRES_FULL_LIBCPP=y

# Pigweed
CONFIG_PIGWEED_LOG_ZEPHYR=y
CONFIG_PIGWEED_ASSERT_ZEPHYR=y
CONFIG_PIGWEED_DIGITAL_IO=y
CONFIG_PIGWEED_THREAD_SLEEP=y
# pw_thread_zephyr.sleep links pw_thread.thread, but PIGWEED_THREAD_SLEEP
# doesn't select it.
CONFIG_PIGWEED_THREAD=y
```

## src/main.cc
```c
#include <zephyr/drivers/gpio.h>

#include "pw_assert/check.h"
#include "pw_chrono/system_clock.h"
#include "pw_digital_io_zephyr/digital_io.h"
#include "pw_log/log.h"
#include "pw_thread/sleep.h"

int main() {
  using namespace std::chrono_literals;

  pw::digital_io::ZephyrDigitalOut led(GPIO_DT_SPEC_GET(DT_ALIAS(led0), gpios));
  PW_CHECK_OK(led.Enable());
  bool led_on = false;
  while (true) {
    led_on = !led_on;
    PW_CHECK_OK(led.SetState(led_on ? pw::digital_io::State::kActive
                                    : pw::digital_io::State::kInactive));
    PW_LOG_INFO("LED state: %s", led_on ? "ON" : "OFF");
    pw::this_thread::sleep_for(pw::chrono::SystemClock::for_at_least(100ms));
  }
}
```
