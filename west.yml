## west.yml
```yaml
manifest:
  remotes:
    - name: zephyrproject-rtos
      url-base: https://github.com/zephyrproject-rtos
    - name: pigweed
      url-base: https://pigweed.googlesource.com/pigweed

  projects:
    - name: zephyr
      remote: zephyrproject-rtos
      revision: v4.5.0-rc3
      import:
        name-allowlist:
          - cmsis_6
          - hal_stm32

    - name: pigweed
      remote: pigweed
      # Pigweed has no releases; pin a commit from main.
      revision: 4c1ee374c3c77da81226e695f8b73c8f0edd5f6f
      path: modules/lib/pigweed

  self:
    path: microhello
```
